## config/boards/shields/abomination/Kconfig.shield
```kconfig
# Copyright (c) 2020 Pete Johanson
# SPDX-License-Identifier: MIT

config SHIELD_ABOMINATION_LEFT
	def_bool $(shields_list_contains,abomination_left)

config SHIELD_ABOMINATION_RIGHT
	def_bool $(shields_list_contains,abomination_right)
```

## config/boards/shields/cyberspace60/Kconfig.defconfig
```kconfig
if shield_CYBERSPACE60

config ZMK_KEYBOARD_NAME
    default "Cyberspace 60"

endif
```
